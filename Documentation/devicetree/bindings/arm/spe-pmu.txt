## Documentation/devicetree/bindings/arm/spe-pmu.txt
```
* ARMv8.2 Statistical Profiling Extension (SPE) Performance Monitor Units (PMU)

ARMv8.2 introduces the optional Statistical Profiling Extension for collecting
performance sample data using an in-memory trace buffer.

** SPE Required properties:

- compatible : should be one of:
	       "arm,statistical-profiling-extension-v1"

- interrupts : Exactly 1 PPI must be listed. For heterogeneous systems where
               SPE is only supported on a subset of the CPUs, a PPI partition
	       described in the arm,gic-v3 binding must be used to describe
	       the set of CPUs this interrupt is affine to.

** Example:

spe-pmu {
        compatible = "arm,statistical-profiling-extension-v1";
        interrupts = <GIC_PPI 05 IRQ_TYPE_LEVEL_HIGH &part1>;
};
```

## Documentation/devicetree/bindings/virtio/mmio.txt
```
* virtio memory mapped device

See http://ozlabs.org/~rusty/virtio-spec/ for more details.

Required properties:

- compatible:	"virtio,mmio" compatibility string
- reg:		control registers base address and size including configuration space
- interrupts:	interrupt generated by the device

Required properties for virtio-iommu:

- #iommu-cells:	When the node describes a virtio-iommu device, it is
		linked to DMA masters using the "iommus" property as
		described in devicetree/bindings/iommu/iommu.txt. For
		virtio-iommu #iommu-cells must be 1, each cell describing
		a single endpoint ID.

Example:

	virtio_block@3000 {
		compatible = "virtio,mmio";
		reg = <0x3000 0x100>;
		interrupts = <41>;
	}
```

## drivers/acpi/arm64/Kconfig
```kconfig
# SPDX-License-Identifier: GPL-2.0-only
#
# ACPI Configuration for ARM64
#

config ACPI_GTDT
	bool
```
